/include/ "system-conf.dtsi"
/ {
};

&spi0 {
	status = "okay";

        adc@0 {
            compatible = "ti,adc122s021";
            reg = <0>;
            spi-max-frequency = <2000000>;
            #io-channel-cells = <1>;
        };
    };

